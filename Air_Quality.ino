
//libraries
#include <Wire.h>
#include <Adafruit_SCD30.h>
#include <Adafruit_GFX.h>
#include <Adafruit_SSD1306.h>

Adafruit_SCD30  scd30;

#define SCREEN_WIDTH 128 
#define SCREEN_HEIGHT 32 

Adafruit_SSD1306 display(SCREEN_WIDTH, SCREEN_HEIGHT, &Wire, -1);

static const unsigned char PROGMEM logospash[] =
{0x07, 0xe4, 0x3f, 0x0f, 0xc0, 0x3f, 0x00, 0x3e, 0x47, 0xff, 0xe0, 0xf9, 0x00, 0x01, 0x80, 0x00, 
0x1c, 0x1c, 0x0c, 0x03, 0x00, 0xe1, 0xc0, 0x61, 0xc6, 0x18, 0x61, 0x87, 0x00, 0x03, 0x80, 0x00, 
0x38, 0x0c, 0x0c, 0x03, 0x01, 0xc0, 0xe0, 0xc0, 0xc4, 0x18, 0x23, 0x03, 0x00, 0x06, 0x80, 0x03, 
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0x3f, 0xff, 0xff, 0xff, 0xff, 0xff, 0xff, 0xff, 0xff, 0xff, 0xff, 0xfe, 0x0e, 0xc2, 0x00, 0x00};

void setup() {
  Serial.begin(115200);

  if(!display.begin(SSD1306_SWITCHCAPVCC, 0x3C)) { 
    Serial.println(F("SSD1306 allocation failed"));
    for(;;);
  }

  display.clearDisplay();
  display.drawBitmap(0, 0, logospash, 128, 32, 1);
  display.setTextSize(1); 
  display.setTextColor(WHITE); 
  display.setCursor(0, 0);
  display.display();
  delay(5000); 

  if (!scd30.begin()) {
    Serial.println("Failed to find SCD30 chip");
    while (1) { delay(10); }
  }
}

void loop() {
  if (scd30.dataReady()){
  Serial.println("Data available!");

  if (!scd30.read()){
  Serial.println("Error reading sensor data"); return; } 

  Serial.print("Temp: ");                                            
  Serial.println(scd30.temperature);
  Serial.print("Humidity: ");
  Serial.println(scd30.relative_humidity);
  Serial.print("CO2: ");
  Serial.println(scd30.CO2, 2);

  display.clearDisplay();
  display.setTextSize(1);

  display.setCursor(0,0);
  display.println("Temperature: ");
  display.setCursor(75,0);
  display.print(scd30.temperature);
  display.println(" C");

  display.setCursor(0,8);
  display.println("Humidity: ");
  display.setCursor(57,8);
  display.print(scd30.relative_humidity);
  display.println(" %");

  display.setCursor(0,16);
  display.println("Co2: ");
  display.setCursor(27,16);
  display.print(scd30.CO2, 2);
  display.println(" ppm");

  display.display();
  delay(2000);
  Serial.print("test");
  } else {
    //Serial.println("No data");
  }
}
